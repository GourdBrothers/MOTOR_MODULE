;=========================================================
;==  RamDefine.inc
;==  
;==  user RAM range: 0x60~0x9f
;=========================================================

#define         Buffer0   0x9F
#define         Buffer1   0x9E 
#define         Buffer2   0x9D 
#define         Buffer3   0x9C  
#define         Buffer4   0x9B   
#define         Buffer5   0x9A   
#define         Buffer6   0x99   
                
#define         TempRam1  0x98  
#define         TempRam2  0x97  
#define         TempRam3  0x96  
#define         TempRam4  0x95  
#define         TempRam5  0x94 
#define         TempRam6  0x93  
                
#define         TempRam11 0x92 
#define         TempRam12 0x91 
#define         TempRam13 0x90 
